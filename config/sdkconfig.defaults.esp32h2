## config/sdkconfig.defaults.esp32h2
```kconfig
CONFIG_IDF_TARGET="esp32h2"

CONFIG_PARTITION_TABLE_CUSTOM=y
CONFIG_PARTITION_TABLE_CUSTOM_FILENAME="partitions.csv"
CONFIG_PARTITION_TABLE_FILENAME="partitions.csv"
# Увеличиваем размер Flash (у H2 обычно 2MB или 4MB)
CONFIG_ESPTOOLPY_FLASHSIZE_4MB=y
```

## sdkconfig.defaults
```kconfig
# Для корректной работы Matter
CONFIG_MBEDTLS_HKDF_C=y
CONFIG_MBEDTLS_HARDWARE_AES=y
CONFIG_MBEDTLS_HARDWARE_SHA=y
CONFIG_ESP_MATTER_OT_INIT=y
```
