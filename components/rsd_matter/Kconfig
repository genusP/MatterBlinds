## main/Kconfig
```kconfig
menu "Rollershade Driver"

menu "Конфигурация датчика положения"

config POSITION_SENSOR_POWER_PIN
    int "Пин питания для датчика положения"
    range 0 39
    default 5
    help
        Номер GPIO пина для питания потенциометра.
        Этот пин будет устанавливаться в HIGH только во время измерений
        для снижения энергопотребления.

config POSITION_SENSOR_ADC_UNIT
    int "ADC блок"
    range 1 2
    default 1
    help
        Блок ADC для использования (1 для ADC1, 2 для ADC2).

config POSITION_SENSOR_ADC_CHANNEL
    int "ADC канал"
    range 0 10
    default 3
    help
        Номер ADC канала для датчика положения.

config POSITION_SENSOR_ADC_ATTENUATION
    int "Ослабление ADC"
    range 0 3
    default 3
    help
        Уровень ослабления ADC:
        0 = 0 dB ослабление (диапазон 1.1V)
        1 = 2.5 dB ослабление (диапазон 1.5V)
        2 = 6 dB ослабление (диапазон 2.2V)
        3 = 11 dB ослабление (диапазон 3.9V)

config POSITION_SENSOR_STABILIZATION_MS
    int "Время стабилизации питания"
    range 1 100
    default 10
    help
        Время в миллисекундах для ожидания после включения питания датчика
        перед снятием показаний.

config ZEBRA_BLINDS_SUPPORT
    bool "Поддержка штор зебра"
    default n
    help
        Включить поддержку штор зебра с дополнительной калибровкой смещения.
        При включении добавляется третий этап калибровки для установки смещения.

endmenu

menu "Конфигурация внешней интеграции"

config EXTERNAL_INTEGRATION
    int "Тип внешней интеграции"
    range 0 2
    default 0
    help
        Выберите тип внешней интеграции:
        0 - Без интеграции
        1 - Интеграция через Matter
        2 - Интеграция через MQTT

config POSITION_UPDATE_PERIOD_MS
    int "Период обновления позиции"
    default 5000

config MQTT_BROKER_HOST
    string "MQTT брокер хост"
    default "192.168.1.100"
    depends on EXTERNAL_INTEGRATION = 2
    help
        IP адрес или доменное имя MQTT брокера.

config MQTT_BROKER_PORT
    int "MQTT брокер порт"
    range 1 65535
    default 1883
    depends on EXTERNAL_INTEGRATION = 2
    help
        Порт MQTT брокера (обычно 1883 для незащищенного, 8883 для SSL).

config MQTT_CLIENT_ID
    string "MQTT клиент ID"
    default "Rollershade Driver"
    depends on EXTERNAL_INTEGRATION = 2
    help
        Уникальный идентификатор клиента для MQTT брокера.

config MQTT_USERNAME
    string "MQTT имя пользователя"
    default ""
    depends on EXTERNAL_INTEGRATION = 2
    help
        Имя пользователя для аутентификации на MQTT брокере.
        Оставьте пустым если аутентификация не требуется.

config MQTT_PASSWORD
    string "MQTT пароль"
    default ""
    depends on EXTERNAL_INTEGRATION = 2
    help
        Пароль для аутентификации на MQTT брокере.
        Оставьте пустым если аутентификация не требуется.

config MQTT_TOPIC
    string "MQTT топик"
    default "rollershade"
    depends on EXTERNAL_INTEGRATION = 2
    help
        Топик для взаимодействия.

config MQTT_USE_SSL
    bool "Использовать SSL для MQTT"
    default n
    depends on EXTERNAL_INTEGRATION = 2
    help
        Включить защищенное соединение с MQTT брокером через SSL/TLS.

config MQTT_HA_DISCOVERY_ENABLED
    bool "Включить Home Assistant MQTT Discovery"
    default y
    depends on EXTERNAL_INTEGRATION = 2
    help
        Автоматически публиковать конфигурацию для автообнаружения в Home Assistant.
        Устройство будет автоматически добавлено в Home Assistant какcover (шторы).

config MQTT_HA_DEVICE_NAME
    string "Имя устройства для Home Assistant"
    default "Rollershade Driver"
    depends on MQTT_HA_DISCOVERY_ENABLED
    help
        Имя устройства которое будет отображаться в Home Assistant.

config MQTT_HA_DEVICE_ID
    string "ID устройства для Home Assistant"
    default "rsd_001"
    depends on MQTT_HA_DISCOVERY_ENABLED
    help
        Уникальный идентификатор устройства для Home Assistant.
        Должен быть уникальным для каждого устройства.

config MQTT_HA_COVER_NAME
    string "Имя cover для Home Assistant"
    default "Rollershade"
    depends on MQTT_HA_DISCOVERY_ENABLED
    help
        Имя cover (штор) которое будет отображаться в Home Assistant.

config MQTT_HA_DISCOVERY_PREFIX
    string "Префикс для Home Assistant Discovery"
    default "homeassistant"
    depends on MQTT_HA_DISCOVERY_ENABLED
    help
        Префикс для топиков автообнаружения Home Assistant.
        Обычно используется "homeassistant".

endmenu

menu "Конфигурация мотора управления"

config MOTOR_PIN_REV
    int "GPIO пин для мотора"
    range 0 39
    default 13
    help
        Номер GPIO пина для вращения назад.

config MOTOR_PIN_FWD
    int "GPIO пин для мотора"
    range 0 39
    default 12
    help
        Номер GPIO пина для вращения вперед.

config MOTOR_STALL_CONTROL
    bool "Контролировать заклинивание мотора"
    default y
    help
        Отключить при работе с симулятором

endmenu

menu "Конфигурация кнопок"

config BUTTON_UP_PIN
    int "GPIO пин для кнопки ВВЕРХ"
    range 0 39
    default 0
    help
        Номер GPIO пина для кнопки движения вверх.

config BUTTON_DOWN_PIN
    int "GPIO пин для кнопки ВНИЗ"
    range 0 39
    default 2
    help
        Номер GPIO пина для кнопки движения вниз.

endmenu
endmenu
```

## sdkconfig.defaults.esp32s3
```kconfig
CONFIG_IDF_TARGET="esp32s3"
CONFIG_PARTITION_TABLE_CUSTOM=y
CONFIG_PARTITION_TABLE_CUSTOM_FILENAME="partitions_esp32s3.csv"
CONFIG_ESPTOOLPY_FLASHSIZE_4MB=y

# Button and sensor configuration
CONFIG_BUTTON_UP_PIN=4
CONFIG_BUTTON_DOWN_PIN=5
CONFIG_POSITION_SENSOR_POWER_PIN=1
CONFIG_POSITION_SENSOR_ADC_CHANNEL=1
```
